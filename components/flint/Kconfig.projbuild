## components/flint/Kconfig.projbuild
```kconfig
menu "FlinT applications"
    config FLINT_LUA_RUNTIME
        bool "Enable the bounded Ignite Lua runtime"
        default n
        help
            Uses the Lua source selection and limits from the pinned IgniteSDK.
    config FLINT_INTERNAL_MEMORY_RESERVE
        int "Internal RAM reserve for DMA, transport peaks and recovery (bytes)"
        range 16384 131072
        default 32768
        help
            Excluded from every application launch preflight. PSRAM never replaces it.
    config FLINT_PSRAM_MEMORY_RESERVE
        int "PSRAM reserve for shared services (bytes)"
        range 0 262144
        default 8192
endmenu
```
